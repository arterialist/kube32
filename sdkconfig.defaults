## sdkconfig.defaults
```kconfig
CONFIG_COMPILER_CXX_EXCEPTIONS=y
CONFIG_COMPILER_CXX_EXCEPTIONS_EMG_POOL_SIZE=1024
CONFIG_ESP_MAIN_TASK_STACK_SIZE=24576
CONFIG_ESPTOOLPY_FLASHSIZE_8MB=y
CONFIG_PARTITION_TABLE_CUSTOM=y
CONFIG_PARTITION_TABLE_CUSTOM_FILENAME="partitions.csv"
CONFIG_PARTITION_TABLE_FILENAME="partitions.csv"
CONFIG_ESP32S3_SPIRAM_SUPPORT=y
CONFIG_SPIRAM_MODE_QUAD=y
CONFIG_SPIRAM_TYPE_AUTO=y
CONFIG_SPIRAM_IGNORE_NOTFOUND=y
CONFIG_SPIRAM_USE_MALLOC=y
CONFIG_LWIP_MAX_SOCKETS=32
CONFIG_ESP_CONSOLE_UART_DEFAULT=y
CONFIG_ESP_CONSOLE_SECONDARY_USB_SERIAL_JTAG=y
CONFIG_LWIP_NETIF_LOOPBACK=y
CONFIG_LWIP_LOOPBACK_MAX_PBUFS=16
CONFIG_ESP_WIFI_STATIC_RX_BUFFER_NUM=6
CONFIG_ESP_WIFI_DYNAMIC_RX_BUFFER_NUM=16
CONFIG_ESP_WIFI_DYNAMIC_TX_BUFFER_NUM=16
CONFIG_ESP_WIFI_RX_BA_WIN=4
# CONFIG_ESP_WIFI_IRAM_OPT is not set
# CONFIG_ESP_WIFI_RX_IRAM_OPT is not set
CONFIG_ESP_WIFI_MGMT_SBUF_NUM=16
# CONFIG_ESP_WIFI_AMPDU_TX_ENABLED is not set
# CONFIG_ESP_WIFI_AMPDU_RX_ENABLED is not set
CONFIG_LWIP_TCP_SND_BUF_DEFAULT=11520
CONFIG_LWIP_TCP_WND_DEFAULT=11520
CONFIG_ESP_DEFAULT_CPU_FREQ_MHZ_240=y
CONFIG_ESP_DEFAULT_CPU_FREQ_MHZ=240
# CONFIG_ESP_TASK_WDT_CHECK_IDLE_TASK_CPU1 is not set
CONFIG_COMPILER_OPTIMIZATION_PERF=y

CONFIG_FREERTOS_GENERATE_RUN_TIME_STATS=y

CONFIG_FREERTOS_USE_TRACE_FACILITY=y

CONFIG_FREERTOS_RUN_TIME_COUNTER_TYPE_U64=y

CONFIG_SPIRAM_MALLOC_ALWAYSINTERNAL=4096

CONFIG_SPIRAM_SPEED_80M=y

# microSD (FATFS over sdspi): the card's sector size, long file names, buffers on the heap
CONFIG_FATFS_SECTOR_512=y
CONFIG_FATFS_LFN_HEAP=y
CONFIG_FATFS_MAX_LFN=255

CONFIG_LWIP_MAX_ACTIVE_TCP=32
```

## src/Kconfig
```kconfig
menu "Kube32"

    config KUBE32_CONSOLE_USB_OTG
        bool "Run the node console over USB OTG (CDC-ACM)"
        default n
        depends on SOC_USB_OTG_SUPPORTED
        help
            The console port is a TinyUSB CDC-ACM device on the USB OTG
            peripheral instead of USB-Serial/JTAG: for boards whose USB port
            is wired to OTG. K32_CMD lines, the log stream and the serial
            gateway run over it. UART0 keeps the boot and panic output. Needs
            CONFIG_TINYUSB_CDC_ENABLED (sdkconfig.defaults.usb-otg).

    config KUBE32_CONSOLE_USB_OTG_GUARD_SECONDS
        int "Seconds to wait for a console line before going back to USB-Serial/JTAG"
        default 0
        range 0 3600
        depends on KUBE32_CONSOLE_USB_OTG
        help
            On chips where OTG and USB-Serial/JTAG share the USB PHY: when no
            console line arrives over OTG this long after boot, the node
            restarts with the PHY given back to USB-Serial/JTAG for one boot.
            For bring-up of a board with no other way back; 0 is off.

    config KUBE32_CONSOLE_USB_OTG_RING_BYTES
        int "Console output kept for a host, in bytes"
        default 4096
        range 1024 65536
        depends on KUBE32_CONSOLE_USB_OTG
        help
            Output waits here for the CDC port, and while no host has the
            port open the newest output stays here for the next host: the
            boot log, for one. Internal RAM.

endmenu
```
